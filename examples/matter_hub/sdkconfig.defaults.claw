## examples/matter_hub/sdkconfig.defaults.claw
```kconfig
CONFIG_HTTP_SERVER_CLAW_ENABLE=y
CONFIG_CLAW_MATTER_LUA_ENABLE=y

CONFIG_LUA_MODULE_MAGNETOMETER_CHIP_BMM150=y
CONFIG_LUA_MODULE_CAMERA_ENABLE_VFLIP=n
CONFIG_LUA_MODULE_CAMERA_ENABLE_HMIRROR=n

CONFIG_APP_CLAW_ENABLE_CLI=y
CONFIG_APP_CLAW_LUA_MODULE_CAMERA=y
CONFIG_APP_CLAW_LUA_MODULE_MAGNETOMETER=y
```

## examples/matter_hub/sdkconfig.defaults.xiaozhi
```kconfig
CONFIG_SR_WN_WN9_HIESP=y
CONFIG_XIAOZHI_OTA_URL="https://api.tenclass.net/xiaozhi/ota/"
CONFIG_XIAOZHI_AUDIO_TASK_ALLOC_DYNAMIC=y
CONFIG_XIAOZHI_STACK_IN_PSRAM=y

CONFIG_MQTT_USE_CUSTOM_CONFIG=y
CONFIG_MQTT_TASK_STACK_SIZE=8192
```
