## components/claw_matter_bridge/Kconfig
```kconfig
menu "CLAW Matter bridge"
    config CLAW_MATTER_BRIDGE_GPIO_ALLOWLIST
        hex "GPIO allowlist bit mask"
        default 0x21C00000003C30
        help
            Mask of GPIOs available to CLAW-created devices. Select GPIOs
            that are free and permitted for the target board; exclude pins
            reserved for system peripherals or other hardware owners.
endmenu
```

## components/claw_matter_controller/Kconfig
```kconfig
menu "CLAW Matter controller"
    depends on FABRIC_MANAGER_ENABLE

    config CLAW_MATTER_LUA_ENABLE
        bool "Expose semantic Matter operations to Lua"
        depends on APP_CLAW_CAP_LUA
        default y
        help
            Register the operation-only `matter` Lua module. Automation and
            durable configuration remain owned by the upper application.

    config CLAW_MATTER_MAX_EVENT_SUBSCRIPTIONS
        int "Maximum transient event subscriptions"
        range 1 64
        default 16

    config CLAW_MATTER_EVENT_MAX_CHANGES
        int "Maximum changes in one committed batch"
        range 1 128
        default 16
        help
            A larger committed report batch is dropped in full.

    config CLAW_MATTER_EVENT_QUEUE_DEPTH
        int "Pending committed-batch queue depth"
        range 1 32
        default 4

    config CLAW_MATTER_EVENT_VALUE_JSON_MAX
        int "Maximum copied JSON bytes per value"
        range 32 1024
        default 256
        help
            A value exceeding this bound drops the complete committed batch.

endmenu
```

## components/http_server/Kconfig
```kconfig
menu "HTTP management server"
    config HTTP_SERVER_CLAW_ENABLE
        bool "Enable Claw web features"
        default y
        help
            Enable Claw settings, chat, memory, capabilities, skills and Lua
            web routes. Disabling this affects only the web management UI;
            the firmware's Claw runtime continues to operate. System status,
            network/time settings, Matter management and files remain available.
endmenu
```

## components/local_fabric/Kconfig
```kconfig
menu "Local Fabric"

    config FABRIC_MANAGER_ENABLE
        bool "Enable resolved device manager"
        default y

    config FABRIC_CORE_MAX_LISTENERS
        int "Maximum core listeners"
        range 1 16
        default 4

    config FABRIC_MANAGER_MAX_LISTENERS
        int "Maximum device-manager listeners"
        depends on FABRIC_MANAGER_ENABLE
        range 1 16
        default 4

    config FABRIC_MANAGER_MAX_DEVICES
        int "Maximum resolved devices"
        depends on FABRIC_MANAGER_ENABLE
        range 1 64
        default 16

    config FABRIC_MANAGER_MAX_ENDPOINTS
        int "Maximum reported endpoints"
        depends on FABRIC_MANAGER_ENABLE
        range 1 128
        default 32

    config FABRIC_MANAGER_MAX_CLUSTERS_PER_ENDPOINT
        int "Maximum selected clusters per endpoint"
        depends on FABRIC_MANAGER_ENABLE
        range 1 32
        default 16
        help
            Bounds selected cluster adapters and the per-endpoint cluster mask.

    config FABRIC_MANAGER_MAX_REPORT_FIELDS_PER_ENDPOINT
        int "Maximum selected report fields per endpoint"
        depends on FABRIC_MANAGER_ENABLE
        range 1 64
        default 16
        help
            Bounds decoded semantic property fields retained for each endpoint
            in one atomic report transaction. Higher values increase heap use.

    config FABRIC_MANAGER_MAX_DEVICE_TYPES_PER_ENDPOINT
        int "Maximum Matter device types per endpoint"
        depends on FABRIC_MANAGER_ENABLE
        range 1 16
        default 4
        help
            Bounds Descriptor DeviceTypeList entries retained per endpoint.
            Reports exceeding this limit are rejected atomically.

    config FABRIC_MANAGER_MAX_TAGS_PER_ENDPOINT
        int "Maximum Matter semantic tags per endpoint"
        depends on FABRIC_MANAGER_ENABLE
        range 1 16
        default 4
        help
            Bounds Descriptor TagList entries inspected for an endpoint name.
            Additional tags are ignored; tags never determine topology validity.

    config FABRIC_MANAGER_MAX_REPORT_RELATIONSHIPS
        int "Maximum Matter parent-child relationships per report"
        depends on FABRIC_MANAGER_ENABLE
        range 1 256
        default 64
        help
            Bounds Descriptor PartsList relationships retained in one atomic
            report transaction. Higher values increase transaction heap use.

endmenu
```

## components/matter_bridge/Kconfig
```kconfig
menu "Matter Bridge"
    config MATTER_BRIDGE_MAX_DEVICES
        int "Maximum catalogued bridged devices"
        range 1 16
        default 3
        help
            Total persistent catalog capacity, including chat/skill devices
            and custom/native devices. Each active device costs one Matter
            dynamic endpoint. CONFIG_ESP_MATTER_MAX_DYNAMIC_ENDPOINT_COUNT
            must be at least this value plus the root and aggregator endpoints.
endmenu
```

## examples/matter_bridge/main/Kconfig.projbuild
```kconfig
menu "Matter bridge example"
    config MATTER_BRIDGE_ROUTER_STACK_SIZE
        int "Event router stack size (bytes)"
        range 16384 65536
        default 24576
        help
            Stack budget for routing chat messages through the agent manager,
            session storage and outbound capabilities. The router prefers a
            PSRAM stack; keep PSRAM XiP enabled for flash access from this task.
    config APP_WIFI_SSID
        string
        default ""
    config APP_WIFI_PASSWORD
        string
        default ""
    config APP_SEARCH_HTTP_ALLOWLIST
        string "HTTP request allowlist"
        default ""

    config APP_CLAW_MOSAIC_GSP_ENABLE
        bool "esp-gsp Mosaic UI"
        depends on ESP_BOARD_DEV_DISPLAY_LCD_SUPPORT
        depends on APP_CLAW_CAP_CORE
        depends on APP_CLAW_CAP_SKILL_MGR
        depends on APP_CLAW_CAP_IM_WECHAT
        select MOSAICO_UI_ENABLE
        default n
        help
            The 480x480 Mosaic GSP touch UI (pairing QR, bridged-device
            status, settings) plus esp-mosaico module hot-plug detection.
            Enabled by boards/esp_mosaico/sdkconfig.defaults.board.
endmenu
```

## examples/matter_bridge/sdkconfig.defaults
```kconfig
CONFIG_ESPTOOLPY_FLASHSIZE_16MB=y
CONFIG_PARTITION_TABLE_CUSTOM=y
CONFIG_PARTITION_TABLE_CUSTOM_FILENAME="partitions_16MB.csv"
CONFIG_PARTITION_TABLE_OFFSET=0x9000
CONFIG_SPIRAM=y
CONFIG_SPIRAM_MODE_OCT=y
CONFIG_SPIRAM_SPEED_250M=y
CONFIG_SPIRAM_USE_MALLOC=y
# HTTP and CLAW tasks use PSRAM stacks while accessing NVS/LittleFS.
CONFIG_SPIRAM_XIP_FROM_PSRAM=y
CONFIG_FREERTOS_HZ=1000
CONFIG_ESP_MAIN_TASK_STACK_SIZE=8192
CONFIG_HTTPD_WS_SUPPORT=y
CONFIG_HTTPD_WS_PRE_HANDSHAKE_CB_SUPPORT=y
CONFIG_HTTPD_WS_POST_HANDSHAKE_CB_SUPPORT=y
CONFIG_LWIP_MAX_SOCKETS=20
CONFIG_LWIP_IPV6_AUTOCONFIG=y
CONFIG_LWIP_IPV6_NUM_ADDRESSES=6
CONFIG_LWIP_LOCAL_HOSTNAME="matter-bridge"
CONFIG_MBEDTLS_EXTERNAL_MEM_ALLOC=y
CONFIG_SPIRAM_ALLOW_BSS_SEG_EXTERNAL_MEMORY=y
# Small JSON/string allocations should also prefer PSRAM.
CONFIG_SPIRAM_MALLOC_ALWAYSINTERNAL=0
CONFIG_SPIRAM_MALLOC_RESERVE_INTERNAL=65536
CONFIG_SPIRAM_TRY_ALLOCATE_WIFI_LWIP=y
# Bound DMA buffer use instead of dynamically consuming internal RAM on TX.
CONFIG_ESP_WIFI_STATIC_RX_BUFFER_NUM=6
CONFIG_ESP_WIFI_DYNAMIC_RX_BUFFER_NUM=16
CONFIG_ESP_WIFI_STATIC_TX_BUFFER=y
CONFIG_ESP_WIFI_STATIC_TX_BUFFER_NUM=6
CONFIG_ESP_WIFI_CACHE_TX_BUFFER_NUM=16
CONFIG_ESP_WIFI_RX_BA_WIN=6
CONFIG_NVS_ALLOCATE_CACHE_IN_SPIRAM=y
CONFIG_LITTLEFS_MALLOC_STRATEGY_SPIRAM_PREFER=y
CONFIG_MDNS_TASK_CREATE_FROM_SPIRAM=y
CONFIG_MDNS_MEMORY_ALLOC_SPIRAM=y
CONFIG_FREERTOS_TASK_CREATE_ALLOW_EXT_MEM=y
CONFIG_FATFS_LFN_HEAP=y
CONFIG_VFS_MAX_COUNT=12
CONFIG_LITTLEFS_MAX_PARTITIONS=3
CONFIG_APP_CLAW_SYSTEM_UI_ENABLE=n
CONFIG_APP_CLAW_ENABLE_CLI=n
CONFIG_APP_CLAW_CAP_LUA=y
CONFIG_APP_CLAW_CAP_IM_LOCAL=y
CONFIG_APP_CLAW_CAP_IM_QQ=y
CONFIG_APP_CLAW_CAP_IM_FEISHU=y
CONFIG_APP_CLAW_CAP_IM_TG=y
CONFIG_APP_CLAW_CAP_IM_WECHAT=y
CONFIG_APP_CLAW_CAP_SYSTEM=n
CONFIG_APP_CLAW_CAP_MCP_CLIENT=n
CONFIG_APP_CLAW_CAP_MCP_SERVER=n
CONFIG_APP_CLAW_LUA_DRIVER_ADC=n
CONFIG_APP_CLAW_LUA_DRIVER_GPIO=n
CONFIG_APP_CLAW_LUA_DRIVER_I2C=n
CONFIG_APP_CLAW_LUA_DRIVER_MCPWM=n
CONFIG_APP_CLAW_LUA_DRIVER_PCNT=n
CONFIG_APP_CLAW_LUA_DRIVER_RMT=n
CONFIG_APP_CLAW_LUA_DRIVER_TOUCH=n
CONFIG_APP_CLAW_LUA_DRIVER_UART=n
CONFIG_APP_CLAW_LUA_MODULE_BOARD_MANAGER=n
CONFIG_APP_CLAW_LUA_MODULE_AUDIO=n
CONFIG_APP_CLAW_LUA_MODULE_BLE=n
CONFIG_APP_CLAW_LUA_MODULE_BLE_HID=n
CONFIG_APP_CLAW_LUA_MODULE_CAMERA=n
CONFIG_APP_CLAW_LUA_MODULE_DISPLAY=n
CONFIG_APP_CLAW_LUA_MODULE_IMAGE=n
CONFIG_APP_CLAW_LUA_MODULE_LEDC=n
CONFIG_APP_CLAW_LUA_MODULE_LED_STRIP=n
CONFIG_APP_CLAW_LUA_MODULE_LVGL=n
CONFIG_APP_CLAW_LUA_MODULE_HTTP_SERVER=n
CONFIG_BT_ENABLED=y
CONFIG_BT_NIMBLE_ENABLED=y
CONFIG_BT_NIMBLE_MEM_ALLOC_MODE_EXTERNAL=y
# CHIPoBLE only ever advertises and serves GATT here, so drop the scanner and
# GATT-client roles NimBLE enables by default.
CONFIG_BT_NIMBLE_ROLE_PERIPHERAL=y
CONFIG_BT_NIMBLE_ROLE_BROADCASTER=y
CONFIG_BT_NIMBLE_ROLE_CENTRAL=n
CONFIG_BT_NIMBLE_ROLE_OBSERVER=n
CONFIG_BT_NIMBLE_MAX_CONNECTIONS=1
CONFIG_BT_NIMBLE_MAX_BONDS=2
# CHIP owns the CHIPoBLE link state; NimBLE must not retry on its own.
CONFIG_BT_NIMBLE_ENABLE_CONN_REATTEMPT=n
CONFIG_ESP_MATTER_ENABLE_MATTER_SERVER=y
CONFIG_ESP_MATTER_ENABLE_DATA_MODEL=y
CONFIG_ESP_MATTER_ENABLE_GENERATED_DATA_MODEL=n
CONFIG_ESP_MATTER_CONTROLLER_ENABLE=n
CONFIG_ESP_MATTER_COMMISSIONER_ENABLE=n
CONFIG_ENABLE_CHIP_CONTROLLER_BUILD=n
CONFIG_ESP_MATTER_ENABLE_OPENTHREAD=n
CONFIG_ENABLE_MATTER_OVER_THREAD=n
CONFIG_ENABLE_ESP32_BLE_CONTROLLER=n
CONFIG_ESP_MATTER_MAX_DYNAMIC_ENDPOINT_COUNT=5
CONFIG_ESP_MATTER_AGGREGATOR_ENDPOINT_COUNT=1
CONFIG_ESP_MATTER_MEM_ALLOC_MODE_EXTERNAL=y
CONFIG_CHIP_MEM_ALLOC_MODE_EXTERNAL=y
CONFIG_CHIP_TASK_STACK_SIZE=8192
CONFIG_HTTP_REUSE_ENABLE=n
# Matter's ESP32 route hook needs these lwIP hooks to publish the fabric's
# off-link IPv6 route and default gateway.
CONFIG_LWIP_HOOK_IP6_ROUTE_DEFAULT=y
CONFIG_LWIP_HOOK_ND6_GET_GW_DEFAULT=y
```

## examples/matter_hub/components/camera_buffer_pool/Kconfig
```kconfig
menu "Camera buffer pool"

    config CAMERA_BUFFER_POOL_ENABLE
        bool "Reserve camera image buffers at startup"
        depends on SPIRAM && IDF_TARGET_ESP32S31
        default n

    config CAMERA_BUFFER_POOL_CAPTURE_BYTES
        int "Capture arena and discard-buffer capacity, each in bytes"
        depends on CAMERA_BUFFER_POOL_ENABLE
        range 614400 8388608
        default 1843200
        help
            Supports one 1280x720 YUV422 frame or two 640x480 frames.
            An equally sized discard buffer keeps DMA away from borrowed frames.

    config CAMERA_BUFFER_POOL_PREVIEW_BYTES
        int "Capacity of each of the two preview buffers, in bytes"
        depends on CAMERA_BUFFER_POOL_ENABLE
        range 460800 4194304
        default 460800

endmenu
```
